## conf/distro/tritium-distro-wayland.conf
```bitbake
require conf/distro/poky.conf

DISTRO = "tritium-distro-wayland"
DISTRO_NAME = "Tritium Wayland"
MAINTAINER = "Bhargav R"

DISTRO_FEATURES += " \
		alsa \
		usbgadget \
		usbhost \
		bluez5 \
		x11 \
		wayland \
		opengl \
		systemd \
		"

DISTRO_FEATURES:remove = "x11"
PACKAGECONFIG:append:pn-virtual/mesa = "gallium lima"

VIRTUAL-RUNTIME_init_manager = "systemd"
DISTRO_FEATURES_BACKFILL_CONSIDERED = "sysvinit"
VIRTUAL-RUNTIME_initscripts = ""
```

## conf/machine/tritium-h5.conf
```bitbake
#@TYPE: Machine
#@NAME: libretech tritium h5 machine
#@DESCRIPTION: Reference machine configuration https://libre.computer/products/all-h3-cc
require conf/machine/include/arm/armv8a/tune-cortexa53.inc
require conf/machine/include/soc-family.inc

SOC_FAMILY = "sun50i"
MACHINEOVERRIDES =. "sun50i:tritium-h5:"

WKS_FILE ?= "tritium-h5.wks"
IMAGE_FSTYPES += "tar.bz2 wic.bz2 wic.bmap"
IMAGE_BOOT_FILES += " Image sun50i-h5-libretech-all-h3-cc.dtb boot.scr"
do_image_wic[depends] += "mtools-native:do_populate_sysroot dosfstools-native:do_populate_sysroot virtual/bootloader:do_deploy"

SERIAL_CONSOLES ?= "115200;ttyS0 "
SERIAL_CONSOLES_CHECK = "${SERIAL_CONSOLES}"

PREFERRED_PROVIDER_virtual/kernel ?= "linux-yocto"
PREFERRED_VERSION_linux-yocto ?= "5.15%"
PREFERRED_PROVIDER_virtual/bootloader ?= "u-boot"

# KERNEL CONFIG
MACHINE_EXTRA_RRECOMMENDS = "kernel-modules kernel-devicetree"
MACHINE_ESSENTIAL_EXTRA_RDEPENDS += "kernel-devicetree kernel-image-image kernel-modules"
KERNEL_IMAGETYPE = "Image"
KERNEL_DEVICETREE = "allwinner/sun50i-h5-libretech-all-h3-cc.dtb"
KERNEL_EXTRA_ARGS += " "
LINUX_VERSION_EXTENSION ?= "-tritium-h5"

# U-BOOT/BOOTLOADER CONFIG
EXTRA_IMAGEDEPENDS += "virtual/bootloader"
UBOOT_ENTRYPOINT ?= "0x45000000"
UBOOT_MACHINE = "libretech_all_h3_cc_h5_defconfig"

#UBOOT_BINARY ?= ""
SPL_BINARY ?= "u-boot-sunxi-with-spl.bin"

# GENERAL
MACHINE_FEATURES ?= "alsa apm keyboard rtc serial screen usbgadget usbhost vfat"
```

## wic/tritium-h5.wks
```
# The disk layout used is:
#  - ------------------------- ----------------------------
# | | u-boot with sunxi spl |     boot     |    rootfs    |
#  - ------------------------- ----------------------------
# ^ ^                       ^              ^              ^
# | |                       |              |              |
# 0 |                      8MiB          72MiB          72MiB + rootfs + IMAGE_EXTRA_SPACE (default 10MiB)
#   8kB
#
#
part u-boot-spl --source rawcopy --sourceparams="file=u-boot-sunxi-with-spl.bin" --ondisk mmcblk --no-table --align 8
part /boot --source bootimg-partition --ondisk mmcblk --fstype=vfat --label boot --active --align 8192 --size 128
part / --source rootfs --ondisk mmcblk --fstype=ext4 --label root --align 8192
```
